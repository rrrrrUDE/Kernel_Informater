## kernel/Kconfig
```kconfig
menuconfig KI
	bool "Kernel Informater"
	default n
	help
	  Kernel Informater provides kernel information management,
	  runtime control, userspace communication and hook interfaces.

if KI

config KI_DEBUG
	bool "Kernel Informater debug"
	default n
	help
	  Enable kernel-side debug logging for Kernel Informater.

config KI_BOOTAPPLY
	bool "Kernel Informater boot apply"
	default n
	help
	  Apply persistent configuration from /data/adb/ki_user/config at boot.
	  The configuration remains applied in kernel memory while active; this
	  does not perform periodic config file reads. Userspace config changes
	  explicitly synchronize the kernel configuration.

config KI_TRACEPOINT_HOOK
	bool "Tracepoint Syscall Redirect as GKI Hook"
	default n
	help
	  The standard, upstream method for modern kernels.
	  Utilizes GKI tracepoints for syscall redirection.
	  The implementation is only for devices with GKI2 support.
	  Support for kernel 5.10+

endif
```
